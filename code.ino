/**
   * @file KSR-ATT85.ino
   * @brief Communication entre l'afficheur STONE HMI, Arduino MEGA et action des casiers du B.R.A.S
   * documentation : https://docs.ks-infinite.fr/bras/
   * github : https://github.com/kerogs/bras/
   * @author Kerogs
   * @version 1.1.3
   * @date 29/05/2024
   * @copyright Copyright - B.R.A.S, Kerogs Infinite, Lycée Condorcet - Stiring-Wendel
   */

#include <SPI.h>
#include <Wire.h>
#include <Adafruit_GFX.h>
#include <Adafruit_SSD1306.h>
// #include <TEA5767Radio.h>
#include <KS_TEA5767.h>


// SSD1306
#define SCREEN_WIDTH 128
#define SCREEN_HEIGHT 32
#define OLED_RESET -1
#define SCREEN_ADDRESS 0x3C
Adafruit_SSD1306 display(SCREEN_WIDTH, SCREEN_HEIGHT, &Wire, OLED_RESET);

// TEA5767
KS_TEA5767 radio;

// Button
const int btnLeft = 2;
const int btnCenter = 3;
const int btnRight = 4;


// 'logo-vertical_bmp', 128x32px
const unsigned char ks_logo_vertical_bmp[] PROGMEM = {
  0xff, 0xff, 0xff, 0xff, 0xff, 0xff, 0xff, 0xff, 0xff, 0xff, 0xff, 0xff, 0xff, 0xff, 0xff, 0xff,
  0x81, 0xff, 0xe0, 0x3f, 0xff, 0xff, 0xff, 0xff, 0xff, 0xff, 0xff, 0x8f, 0xff, 0xc7, 0xff, 0xbf,
  0x00, 0xff, 0x80, 0x30, 0xff, 0xc7, 0xc3, 0xc0, 0x3c, 0x03, 0xfc, 0x01, 0xff, 0x00, 0xfc, 0x07,
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  0xff, 0xff, 0xff, 0xff, 0xff, 0xff, 0xff, 0xff, 0xff, 0xff, 0xff, 0xff, 0xff, 0xff, 0xff, 0xff
};

// Array of all bitmaps for convenience. (Total bytes used to store images in PROGMEM = 528)
const int ks_allArray_LEN = 1;
const unsigned char* ks_allArray[1] = {
  ks_logo_vertical_bmp
};

// LedRGB
const int ledR = 9;
const int ledG = 10;
const int ledB = 11;


// don't change
float frequency = 104.5;
char* station = "";
int lastRSSIdBm = 0;

void setup() {
  Serial.begin(9600);
  delay(1000);
  Serial.println("[STARTING...]");
  Wire.begin();

  if (!display.begin(SSD1306_SWITCHCAPVCC, SCREEN_ADDRESS)) {
    Serial.println(F("SSD1306 allocation failed"));
    for (;;)
      ;  // Don't proceed, loop forever
  }

  display.setTextSize(1);
  display.setTextColor(WHITE);
  display.setCursor(0, 0);

  display.display();
  display.clearDisplay();
  display.display();
  display.drawBitmap(0, 0, ks_logo_vertical_bmp, 128, 32, 1);
  display.display();

  delay(6000);
  display.clearDisplay();

  display.setCursor(30, 0);
  display.setTextSize(0.1);
  display.print("KSR-ATmega368");
  display.setCursor(0, 15);
  display.println(F("https://github.com"));
  display.println(F("/KSInfinite"));
  display.display();
  delay(2000);

  display.clearDisplay();
  display.display();
  display.setCursor(0, 0);
  display.println("[STARTING]");
  display.display();

  pinMode(ledR, OUTPUT);
  display.print(".");
  display.display();

  pinMode(ledG, OUTPUT);
  display.print(".");
  display.display();

  pinMode(ledB, OUTPUT);
  display.print(".");
  display.display();

  ledRGB(255, 0, 255);



  radio.begin();
  display.print(".");
  display.display();

  int stateLeft = digitalRead(btnLeft);
  display.print(".");
  display.display();
  int stateCenter = digitalRead(btnCenter);
  display.print(".");
  display.display();
  int stateRight = digitalRead(btnRight);
  display.print(".");
  display.display();

  delay(500);

  Serial.println("[END]");
  display.print("[END]");
  display.display();
  delay(500);
  display.clearDisplay();
  display.display();
  Serial.println("[END...]");
  ledRGB(0, 255, 0);

  radio.setFrequency(frequency);
  btnAction(stateLeft, stateCenter, stateRight, frequency);
  updateScreen(frequency);
  display.setTextSize(2);
  display.setCursor(0, 16);
  display.print(frequency);
  display.print(" MHz");
  display.display();
}

// ---------- LOOP ----------
void loop() {
  int stateLeft = digitalRead(btnLeft);
  int stateCenter = digitalRead(btnCenter);
  int stateRight = digitalRead(btnRight);

  // [screen updates only on action (limits I2C half-duplex problems)]
  if (stateLeft || stateCenter || stateRight) {

    screenClear();

    btnAction(stateLeft, stateCenter, stateRight, frequency);
    updateScreen(frequency);
    radio.setFrequency(frequency);

    // show frequency
    display.setTextSize(2);
    display.setCursor(0, 16);
    display.print(frequency);
    display.print(" MHz");

    delay(300);

    display.display();
  }
}

// ---------- updateScreen ----------
void updateScreen(int frequency) {

  int RSSIdBm = radio.getRSSIdBm(radio.getRSSI());

  display.setCursor(0, 0);
  display.setTextSize(1);
  display.print(RSSIdBm);
  display.print(" dBm");
}

// ---------- screenClear ----------
void screenClear() {
  display.display();
  // delay(2000);
  display.clearDisplay();
}

// ---------- btnAction ----------
void btnAction(int stateLeft, int stateCenter, int stateRight, float& frequency) {
  char* action = "-";

  if (stateLeft == 1) {
    frequency -= 0.1;
  } else if (stateCenter == 1) {
  } else if (stateRight == 1) {
    frequency += 0.1;
  }
}

// ---------- ledRGB ----------
void ledRGB(int Red, int Green, int Blue) {
  digitalWrite(ledR, Red);
  digitalWrite(ledG, Green);
  digitalWrite(ledB, Blue);
}